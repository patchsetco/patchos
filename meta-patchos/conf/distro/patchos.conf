## meta-patchos/conf/distro/patchos.conf
```bitbake
DISTRO_NAME = "PatchOS"
DISTRO_VERSION = "0.0.1"
DISTRO_CODENAME = "bootstrap"

MAINTAINER = "Patchset Company"

hostname:pn-base-files = "patchos"

INIT_MANAGER = "systemd"
PACKAGE_CLASSES = "package_rpm"

DISTRO_FEATURES:append = " systemd-resolved"

DISTRO_FEATURES_OPTED_OUT = " \
    x11 \
    wayland \
"
```
